#define CONFIG_WIRELESS
#define ZMK_BASE_LAYER(name, X_LT, X_RT, X_LM, X_RM, X_LB, X_RB, X_LH, X_RH)                   \
    ZMK_LAYER(                                                                 \
        name,                                                                  \
                 X_LT X_RT                                                         \
                 X_LM X_RM                                                         \
                 X_LB X_RB                                                         \
        &kp LGUI X_LH X_RH &smart_mouse                                            \
    )

#include "base.keymap"
#include "zmk-helpers/key-labels/42.h"


